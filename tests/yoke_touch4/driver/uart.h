// Mock UART; CRC table is taken from example/ext_periph/mian.c.
#pragma once
#include <Arduino.h>
using uart_port_t=int;
using esp_err_t=int;
constexpr int UART_NUM_1=1,ESP_OK=0,UART_DATA_8_BITS=8,UART_PARITY_DISABLE=0;
constexpr int UART_STOP_BITS_1=1,UART_HW_FLOWCTRL_DISABLE=0,UART_SCLK_DEFAULT=0;
constexpr int UART_PIN_NO_CHANGE=-1;
struct uart_config_t {int baud_rate,data_bits,parity,stop_bits,flow_ctrl,source_clk;};
static bool installed=false;
static std::deque<uint8_t> incoming;
static std::vector<uint8_t> sent;
static int mode=0;
static uint8_t cfgbytes[8]={0,1,2,3,4,5,6,7};
static const uint8_t crc_table[256]={
        0x00, 0x31, 0x62, 0x53, 0xC4, 0xF5, 0xA6, 0x97,
        0xB9, 0x88, 0xDB, 0xEA, 0x7D, 0x4C, 0x1F, 0x2E,
        0x43, 0x72, 0x21, 0x10, 0x87, 0xB6, 0xE5, 0xD4,
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        0x3B, 0x0A, 0x59, 0x68, 0xFF, 0xCE, 0x9D, 0xAC
    };
inline uint8_t crc(const uint8_t* p, size_t len) {
    uint8_t c=0; for(size_t i=0;i<len;i++) c=crc_table[c^p[i]]; return c;
}
inline std::vector<uint8_t> packet(uint8_t cmd,std::vector<uint8_t> data) {
    std::vector<uint8_t> f={0xAA,0x55,cmd,(uint8_t)data.size()};
    f.insert(f.end(),data.begin(),data.end());
    f.push_back(crc(f.data()+2,f.size()-2)); f.push_back(0xEE); return f;
}
inline void enqueue(const std::vector<uint8_t>& data) {
    incoming.insert(incoming.end(),data.begin(),data.end());
}
inline bool uart_is_driver_installed(int) {return installed;}
inline int uart_param_config(int,const uart_config_t* c) {assert(c->baud_rate==9600);return 0;}
inline int uart_driver_install(int,int,int,int,void*,int) {installed=true;return 0;}
inline int uart_driver_delete(int) {installed=false;incoming.clear();return 0;}
inline int uart_set_pin(int,int tx,int rx,int,int) {assert(tx==17 && rx==18);return 0;}
inline int uart_read_bytes(int,uint8_t* p,int,int) {
    if(incoming.empty())return 0; *p=incoming.front();incoming.pop_front();return 1;
}
inline int uart_write_bytes(int,const void* ptr,size_t len) {
    const uint8_t* f=(const uint8_t*)ptr;sent.assign(f,f+len);
    assert(len==f[3]+6U && f[0]==0xAA && f[1]==0x55 && f[len-1]==0xEE);
    assert(crc(f+2,len-4)==f[len-2]);
    uint8_t cmd=f[2];std::vector<uint8_t> data;
    if(cmd==0x21)data={5,0x12,0x34,0xAB,0xCD,0,1,0xFF,0xFE};
    if(cmd==0x22)data={f[4]};
    if(cmd==0x23){assert(f[3]==8);data={1};}
    if(cmd==0x24)data={1};
    if(cmd==0x25)data.assign(cfgbytes,cfgbytes+8);
    if(cmd==0x26){assert(f[3]==9);data={(uint8_t)(1|(f[4]<<4))};}
    if(cmd==0x2F)data={0x10,1};
    auto response=packet(cmd-0x10,data);
    if(mode==1)response[response.size()-2]^=1;
    if(mode==2)response.back()=0;
    if(mode==3)response={0xAA,0x55,0x11,0x40};
    if(mode==4)response={0xAA,0x55,0x11,9,5};
    if(mode==5)response=packet(0x1F,{0x10,1});
    if(mode==6)enqueue({0,1,0xAA});
    if(mode==7)response=packet(0x11,{0,0,0,0,0,0,0,0,0});
    if(mode==8)response=packet(0x11,{0});
    if(mode!=9)enqueue(response);
    if(cmd==0x26)enqueue(packet(0x1F,{0x10,1}));
    return (int)len;
}
